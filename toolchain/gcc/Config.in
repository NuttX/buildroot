## toolchain/gcc/Config.in
```kconfig
# Choose gcc version.

comment "GCC Options"

config BR2_PACKAGE_GCC
	bool "Build GCC cross-compiler"
	default n
	select BR2_PACKAGE_BINUTILS
	help
		Build the GCC cross-compiler for the target architecture.

choice
	prompt "GCC compiler Version"
	default BR2_GCC_VERSION_4_3_3 if BR2_GCC_CORTEX
	default BR2_GCC_VERSION_4_2_4 if !BR2_avr32 && !BR2_GCC_CORTEX && !BR2_m9s12x
	default BR2_GCC_VERSION_3_4_6 if BR2_avr32
	default BR2_GCC_VERSION_3_3_6 if BR2_m9s12x
	depends on BR2_PACKAGE_GCC
	help
		Select the version of gcc you wish to use.

	config BR2_GCC_VERSION_3_3_6
		depends on BR2_m9s12x
		bool "gcc 3.3.6"

    config BR2_GCC_VERSION_3_4_6
		depends on !BR2_m32c && !BR2_GCC_CORTEX
		bool "gcc 3.4.6"

	config BR2_GCC_VERSION_4_2_4
		depends on !BR2_avr32 && !BR2_nios2 && !BR2_GCC_CORTEX && !BR2_m9s12x
		select BR2_GCC_SUPPORTS_SYSROOT
		bool "gcc 4.2.4"

	config BR2_GCC_VERSION_4_3_3
		depends on !BR2_avr32 && !BR2_nios2 && !BR2_m9s12x
		select BR2_GCC_SUPPORTS_SYSROOT
		bool "gcc 4.3.3"

	config BR2_GCC_VERSION_4_5_2
		depends on !BR2_avr32 && !BR2_nios2 && !BR2_m9s12x
		select BR2_GCC_SUPPORTS_SYSROOT
		bool "gcc 4.5.2"

	config BR2_GCC_VERSION_4_6_3
		depends on !BR2_avr32 && !BR2_nios2 && !BR2_m9s12x
		select BR2_GCC_SUPPORTS_SYSROOT
		select BR2_GCC_SUPPORTS_DOWN_PREREQ
		bool "gcc 4.6.3"

	config BR2_GCC_VERSION_4_7_4
		depends on !BR2_avr32 && !BR2_nios2 && !BR2_m9s12x
		select BR2_GCC_SUPPORTS_SYSROOT
		select BR2_GCC_SUPPORTS_DOWN_PREREQ
		bool "gcc 4.7.4"

	config BR2_GCC_VERSION_4_8_5
		depends on !BR2_avr32 && !BR2_nios2 && !BR2_m9s12x
		select BR2_GCC_SUPPORTS_SYSROOT
		select BR2_GCC_SUPPORTS_DOWN_PREREQ
		bool "gcc 4.8.5"

	config BR2_GCC_VERSION_4_9_4
		depends on !BR2_avr32 && !BR2_nios2 && !BR2_m9s12x
		select BR2_GCC_SUPPORTS_SYSROOT
		select BR2_GCC_SUPPORTS_DOWN_PREREQ
		bool "gcc 4.9.4"

	config BR2_GCC_VERSION_5_5_0
		depends on !BR2_avr32 && !BR2_nios2 && !BR2_m9s12x
		select BR2_GCC_SUPPORTS_SYSROOT
		select BR2_GCC_SUPPORTS_DOWN_PREREQ
		bool "gcc 5.5.0"

	config BR2_GCC_VERSION_6_4_0
		depends on !BR2_avr32 && !BR2_nios2 && !BR2_m9s12x
		select BR2_GCC_SUPPORTS_SYSROOT
		select BR2_GCC_SUPPORTS_DOWN_PREREQ
		bool "gcc 6.4.0"

	config BR2_GCC_VERSION_7_3_0
		depends on !BR2_avr32 && !BR2_nios2 && !BR2_m9s12x
		select BR2_GCC_SUPPORTS_SYSROOT
		select BR2_GCC_SUPPORTS_NUTTX_OS
		select BR2_GCC_SUPPORTS_DOWN_PREREQ
		bool "gcc 7.3.0"

endchoice

config BR2_GCC_SUPPORTS_SYSROOT
	bool
	default n

config BR2_GCC_SUPPORTS_NUTTX_OS
	bool
	default n

config BR2_GCC_SUPPORTS_DOWN_PREREQ
	bool
	default n

config BR2_GCC_DOWNLOAD_PREREQUISITES
	bool "Download and build support libraries into gcc"
	depends BR2_GCC_SUPPORTS_DOWN_PREREQ
	default y
	---help---
		Download and build gmp, mpfr, mpc, etc. into GCC as static libraries
		so that the toolchain is more portable and doesn't rely on system
		shared libraries.

config BR2_GCC_VERSION
	string
	default "3.3.6"     if BR2_GCC_VERSION_3_3_6
	default "3.4.6"     if BR2_GCC_VERSION_3_4_6
	default "4.2.4"     if BR2_GCC_VERSION_4_2_4
	default "4.3.3"     if BR2_GCC_VERSION_4_3_3
	default "4.5.2"     if BR2_GCC_VERSION_4_5_2
	default "4.6.3"     if BR2_GCC_VERSION_4_6_3
	default "4.7.4"     if BR2_GCC_VERSION_4_7_4
	default "4.8.5"     if BR2_GCC_VERSION_4_8_5
	default "4.9.4"     if BR2_GCC_VERSION_4_9_4
	default "5.5.0"     if BR2_GCC_VERSION_5_5_0
	default "6.4.0"     if BR2_GCC_VERSION_6_4_0
	default "7.3.0"     if BR2_GCC_VERSION_7_3_0

config BR2_GCC_USE_SJLJ_EXCEPTIONS
	bool "Enable setjmp/longjmp exceptions?"
	default n
	depends on BR2_PACKAGE_GCC
	help
	  For some platforms, proper stack unwinding works perfectly,
	  while other platforms must use setjmp/longjmp exceptions for
	  proper stack unwinding during exception handling.  Most people
	  can leave this set to n.

config BR2_EXTRA_GCC_CONFIG_OPTIONS
	string "Additional gcc options"
	depends on BR2_PACKAGE_GCC
	default ""
	help
	  Any additional gcc configure options you may want to include....

config BR2_INSTALL_LIBSTDCPP
	bool "Build C++ compiler?"
	depends on BR2_PACKAGE_GCC
	default n
	# >= 4.2.0 work fine without LARGEFILE
	select BR2_LARGEFILE if !BR2_GCC_SUPPORTS_SYSROOT
	help
	  Build/install c++ compiler?  NOTE: libstdc++ is not built for NuttX?

config BR2_INSTALL_LIBGCJ
	bool "Build/install java compiler and libgcj?"
	default n
	depends on BR2_PACKAGE_GCC &&  !BR2_avr32 && BR2_INSTALL_LIBSTDCPP
	help
	  Build/install java compiler and libgcj?

config BR2_INSTALL_OBJC
	bool "Build/install Objective-C compiler and runtime?"
	default n
	depends on BR2_PACKAGE_GCC && !BR2_avr32
	help
	  Build/install Objective-C compiler and runtime?

config BR2_INSTALL_FORTRAN
	bool "Build/install Fortran compiler and runtime?"
	default n
	depends on BR2_PACKAGE_GCC && !BR2_avr32
	help
	  Build/install Fortran compiler and runtime?
	  Note that it is highly recommended NOT to use gfortran
	  from gcc older than 4.2.0
```

## toolchain/gdb/Config.in
```kconfig
comment "Gdb Options"

config BR2_PACKAGE_GDB
	bool "Build gdb debugger for the Target"
	default n
	help
	    Build the full gdb debugger to run on the target.

config BR2_PACKAGE_GDB_SERVER
	bool "Build gdb server for the Target"
	default n
	help
	    Build the gdbserver stub to run on the target.
	    A full gdb is needed to debug the progam.

config BR2_PACKAGE_GDB_HOST
	bool "Build gdb for the Host"
	default n
	help
	    Build gdb to run on the host to debug programs run on the target.

choice
	prompt "GDB debugger Version"
	default BR2_GDB_VERSION_6_8A if !BR2_avr32 && !BR2_m9s12x
	default BR2_GDB_VERSION_6_4 if BR2_m9s12x
	default BR2_GDB_VERSION_6_3 if BR2_avr32
	depends on BR2_PACKAGE_GDB || BR2_PACKAGE_GDB_SERVER || BR2_PACKAGE_GDB_HOST
	help
	  Select the version of gdb you wish to use.

	config BR2_GDB_VERSION_6_3
		bool "gdb 6.3"
		depends on !BR2_avr32 && !BR2_nios2

	config BR2_GDB_VERSION_6_4
		bool "gdb 6.3"
		depends on BR2_m9s12x

	config BR2_GDB_VERSION_6_8A
		bool "gdb 6.8a"
		depends on !BR2_avr32

	config BR2_GDB_VERSION_7_4_1
		bool "gdb 7.4.1"
		depends on !BR2_bfin

	config BR2_GDB_VERSION_7_9_1
		bool "gdb 7.9.1"
		depends on !BR2_bfin

endchoice

config BR2_PACKAGE_GDB_TUI
    bool "TUI support"
    select BR2_PACKAGE_NCURSES
	default n
    depends on BR2_PACKAGE_GDB_HOST
    help
      This option enables terminal user interface (TUI) for gdb

      "The GDB Text User Interface (TUI) is a terminal interface
      which uses the curses library to show the source file, the
      assembly output, the program registers and GDB commands in
      separate text windows."

      https://sourceware.org/gdb/current/onlinedocs/gdb/TUI.html

config BR2_GDB_VERSION
	string
	default "6.3"      if BR2_GDB_VERSION_6_3
	default "6.4"      if BR2_GDB_VERSION_6_4
	default "6.8a"     if BR2_GDB_VERSION_6_8A
	default "7.4.1"    if BR2_GDB_VERSION_7_4_1
	default "7.9.1"    if BR2_GDB_VERSION_7_9_1
```

## toolchain/kconfig-frontends/Config.in
```kconfig
config BR2_PACKAGE_KCONFIG_FRONTENDS
	bool "Build kconfig-frontends"
	default y
	help
	  The kconfig-frontends are required to configure NuttX.  See
	  http://ymorin.is-a-geek.org/projects/kconfig-frontends

	  NOTE: You must have the ncurses library installed on your computer

if BR2_PACKAGE_KCONFIG_FRONTENDS

config BR2_NCONF_FRONTEND
	bool "Build nconfig frontend"
	default n
	help
	  NOTE: You must have the ncurses library installed on your computer

config BR2_GCONF_FRONTEND
	bool "Build GTK gconf frontend"
	default n
	help
	  NOTE: You must have the QTK developer library installed on your computer

config BR2_QCONF_FRONTEND
	bool "Build Qt qconfig frontend"
	default n
	help
	  NOTE: You must have the QTK developer library installed on your computer

choice
	prompt "kconfig version"
	default BR2_KCONFIG_VERSION_4_11_0_1
	help
		Select the version of kconfig you wish to use.

	config BR2_KCONFIG_VERSION_3_12_0_0
		bool "kconfig 3.12.0.0"

	config BR2_KCONFIG_VERSION_4_11_0_1
		bool "kconfig 4.11.0.1"

endchoice

config BR2_KCONFIG_FRONTENDS_VERSION
	string
	default "3.12.0.0"   if BR2_KCONFIG_VERSION_3_12_0_0
	default "4.11.0.1"   if BR2_KCONFIG_VERSION_4_11_0_1

endif # BR2_PACKAGE_KCONFIG_FRONTENDS
```
